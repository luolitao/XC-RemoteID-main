## sdkconfig.defaults
```kconfig
# ==========================================
# 1. 单核支持
# ==========================================
CONFIG_FREERTOS_UNICORE=y
CONFIG_FREERTOS_HZ=1000
# 修复 ESP-IDF 5.x 的 Flash 大小识别
CONFIG_ESPTOOLPY_FLASHSIZE_4MB=y

# ==========================================
# 蓝牙配网核心配置 (NimBLE 极简模式)
# ==========================================
CONFIG_BT_ENABLED=y
CONFIG_BT_BLUEDROID_ENABLED=n
CONFIG_BT_NIMBLE_ENABLED=y

# 【关键修复 2】强制控制器仅运行 BLE 模式，彻底禁用经典蓝牙 (BR/EDR)
CONFIG_BTDM_CTRL_MODE_BLE_ONLY=y
CONFIG_BTDM_CTRL_MODE_BR_EDR_ONLY=n
CONFIG_BTDM_CTRL_MODE_BTDM=n

# 极限压缩蓝牙内存占用
CONFIG_BTDM_CTRL_BLE_MAX_CONN=1
CONFIG_BT_NIMBLE_MAX_CONNECTIONS=1
CONFIG_BT_NIMBLE_MEM_ALLOC_MODE_DEFAULT=y

# 仅保留外设角色 (GATT Server)
CONFIG_BT_NIMBLE_ROLE_PERIPHERAL=y
CONFIG_BT_NIMBLE_ROLE_CENTRAL=n
CONFIG_BT_NIMBLE_ROLE_OBSERVER=n
CONFIG_BT_NIMBLE_ROLE_BROADCASTER=n
# ==========================================
# 极限压缩 NimBLE 内存 (关闭不需要的配对和持久化)
# ==========================================
CONFIG_BT_NIMBLE_NVS_PERSIST=n       # 关闭 NVS 持久化 (消除 IRKs 报错)
CONFIG_BT_NIMBLE_SM_BONDING=0        # 禁用绑定
CONFIG_BT_NIMBLE_SM_SC=0             # 禁用安全连接 (Secure Connections)
CONFIG_BT_NIMBLE_SM_LEGACY=0         # 禁用传统配对

# Wi-Fi 与 BLE 软件共存 (单核必备)
CONFIG_ESP_COEX_SW_COEXIST_ENABLE=y

# Wi-Fi 与 BLE 软件共存 (单核必备)
CONFIG_ESP_COEX_SW_COEXIST_ENABLE=y

# ==========================================
# 3. 【核心修复】强制忽略 eFuse MAC CRC 错误
# 这将阻止 phy_init.c 中的 ESP_ERROR_CHECK 导致 abort()
# ==========================================
CONFIG_ESP32_IGNORE_MAC_CRC_ERROR=y
CONFIG_ESP_MAC_IGNORE_MAC_CRC_ERROR=y

# ==========================================
# 4. 【双重保险】强制使用自定义 MAC 作为 Base MAC
# ==========================================
CONFIG_ESP_MAC_USE_CUSTOM_MAC_AS_BASE_MAC=y
CONFIG_ESP_MAC_CUSTOM_MAC_ADDRESS="24:0a:c4:12:34:56"

# ==========================================
# OTA 核心配置
# ==========================================
# 启用应用回滚机制 (防止新固件有 Bug 导致变砖，首次启动成功后需标记为有效)
CONFIG_APP_ROLLBACK_ENABLE=y

# 启用 HTTP Server (用于接收固件上传)
CONFIG_ESP_HTTP_SERVER_ENABLE=y

# 修复 Flash 大小识别错误
CONFIG_ESPTOOLPY_FLASHSIZE="4MB"
CONFIG_ESPTOOLPY_FLASHSIZE_4MB=y
```
